## Documentation/devicetree/bindings/remoteproc/nsing,n32h787-cm4.yaml
```yaml
# SPDX-License-Identifier: (GPL-2.0-only OR BSD-2-Clause)
%YAML 1.2
---
$id: http://devicetree.org/schemas/remoteproc/nsing,n32h787-cm4.yaml#
$schema: http://devicetree.org/meta-schemas/core.yaml#

title: NSING N32H787 Cortex-M4 remote processor

maintainers:
  - Tobby Tan <tan.bo@nsingtech.com>

description: |
  The N32H787 Cortex-M4 boots from a vector table in its AHB SRAM. Linux
  controls reset release through the SoC reset controller and loads ELF
  segments only into the address ranges declared by this node. Exception
  fetches use the AHB SRAM base, so firmware must place its vector table at
  0x30000000.

properties:
  compatible:
    const: nsing,n32h787-cm4

  reg:
    minItems: 2
    maxItems: 2

  reg-names:
    items:
      - const: boot-vector
      - const: dcmu

  interrupts:
    maxItems: 1
    description: DCMU receive-message interrupt shared by the CM7 and CM4.

  nsing,rcc:
    $ref: /schemas/types.yaml#/definitions/phandle
    description: Reset and clock controller containing the CM4 reset release bit.

  nsing,load-regions:
    $ref: /schemas/types.yaml#/definitions/uint32-matrix
    description: |
      Address and size pairs describing the CM4 AHB SRAM ranges into which
      firmware PT_LOAD segments may be loaded.
    minItems: 1
    items:
      items:
        - description: Start address of an allowed CM4 load region
        - description: Size of the load region in bytes

  nsing,heartbeat-address:
    $ref: /schemas/types.yaml#/definitions/uint32
    description: |
      Optional address of a writable 32-bit value that userspace can inspect
      through the remoteproc device heartbeat attribute.

  firmware-name:
    maxItems: 1
    description:
      Optional firmware file initially assigned to the remote processor.
      When omitted, no firmware is preselected and userspace must set one
      through the remoteproc sysfs interface before starting the CM4.

required:
  - compatible
  - reg
  - reg-names
  - interrupts
  - nsing,rcc
  - nsing,load-regions
additionalProperties: false
```

## Documentation/devicetree/bindings/sound/nsing,n32h787-wm8978.yaml
```yaml
# SPDX-License-Identifier: (GPL-2.0-only OR BSD-2-Clause)
%YAML 1.2
---
$id: http://devicetree.org/schemas/sound/nsing,n32h787-wm8978.yaml#
$schema: http://devicetree.org/meta-schemas/core.yaml#

title: NSING N32H787 HMI WM8978 microphone card

maintainers:
  - Tobby Tan <tan.bo@nsingtech.com>

properties:
  compatible:
    const: nsing,n32h787-wm8978
  audio-cpu:
    $ref: /schemas/types.yaml#/definitions/phandle
    description: I2S capture controller
  audio-codec:
    $ref: /schemas/types.yaml#/definitions/phandle
    description: WM8978 codec
  nsing,mclk-frequency:
    $ref: /schemas/types.yaml#/definitions/uint32
    description: MCLK input frequency supplied to the codec PLL
    minimum: 1000000
    maximum: 27000000

required:
  - compatible
  - audio-cpu
  - audio-codec
  - nsing,mclk-frequency

additionalProperties: false
```

## Documentation/devicetree/bindings/sound/nsing,n32h7xx-i2s.yaml
```yaml
# SPDX-License-Identifier: (GPL-2.0-only OR BSD-2-Clause)
%YAML 1.2
---
$id: http://devicetree.org/schemas/sound/nsing,n32h7xx-i2s.yaml#
$schema: http://devicetree.org/meta-schemas/core.yaml#

title: NSING N32H7xx I2S controller

maintainers:
  - Tobby Tan <tan.bo@nsingtech.com>

description: |
  I2S1 and its I2S1_EXT extension both work as clock consumers of an external
  codec and share CK and WS. The main block receives on its SD pin; the
  extension transmits on the SD_EXT pin, so capture and playback are two
  independent halves that may run at the same time. I2S4 generates the codec
  MCLK using its master receiver, whose clock continues without TX data.

allOf:
  - $ref: dai-common.yaml#

properties:
  compatible:
    const: nsing,n32h7xx-i2s
  reg:
    items:
      - description: I2S1 main block registers
      - description: I2S1_EXT extension block registers
      - description: I2S4 MCLK generator registers
  reg-names:
    items:
      - const: rx
      - const: ext
      - const: mclk
  clocks:
    items:
      - description: I2S1 kernel clock
      - description: I2S4 kernel clock
  clock-names:
    items:
      - const: rx
      - const: mclk
  resets:
    minItems: 2
    maxItems: 2
  reset-names:
    items:
      - const: rx
      - const: mclk
  nsing,ws-monitor:
    $ref: /schemas/types.yaml#/definitions/phandle-array
    description: |
      GPIO controller, pin and zero flags identifying the WS input monitor.
      The pin remains muxed to I2S. Its GPIO input register is read to align
      receiver enable to a word boundary without changing the pin function.
    maxItems: 1
  dmas:
    items:
      - description: I2S1 receive DMA
      - description: I2S1 transmit DMA, also used by the extension block
  dma-names:
    items:
      - const: rx
      - const: tx
  '#sound-dai-cells':
    const: 0

required:
  - compatible
  - reg
  - reg-names
  - clocks
  - clock-names
  - resets
  - reset-names
  - nsing,ws-monitor
  - dmas
  - dma-names
  - '#sound-dai-cells'

unevaluatedProperties: false
```

## Documentation/devicetree/bindings/timer/nsing,n32h7xx-btim.yaml
```yaml
# SPDX-License-Identifier: (GPL-2.0-only OR BSD-2-Clause)
%YAML 1.2
---
$id: http://devicetree.org/schemas/timer/nsing,n32h7xx-btim.yaml#
$schema: http://devicetree.org/meta-schemas/core.yaml#

title: NSING N32H7xx basic timer clocksource

maintainers:
  - Tobby Tan <tan.bo@nsingtech.com>

description: |
  A 32-bit basic timer with a 16-bit prescaler, reserved for free-running
  system timekeeping. The clock is the timer kernel clock, not the APB
  register access clock. No interrupt is needed for clocksource operation.

properties:
  compatible:
    const: nsing,n32h7xx-btim

  reg:
    maxItems: 1

  clocks:
    maxItems: 1

  resets:
    maxItems: 1

required:
  - compatible
  - reg
  - clocks
  - resets

additionalProperties: false
```

## arch/arm/mach-nsing/Kconfig
```kconfig
# SPDX-License-Identifier: GPL-2.0-only
menuconfig ARCH_NSING
	bool "NSING SoC support"
	depends on ARM_SINGLE_ARMV7M
	select ARMV7M_SYSTICK_CLOCKEVENT
	select CLKSRC_MMIO
	select RESET_CONTROLLER
	help
	  Support for NSING SoCs.  The current N32H7xx family uses a
	  Cortex-M7 core and boots Linux with the ARMv7-M NOMMU port.
	  Enable this to build platform support for boards using these SoCs.
	  Individual peripheral drivers are selected separately.

if ARCH_NSING

config SOC_N32H7XX
	bool "NSING N32H7xx family"
	default y
	help
	  Support for the NSING N32H7xx family.  N32H787 is the first
	  supported member and combines a Cortex-M7 with a Cortex-M4.
	  Linux runs on the Cortex-M7 and uses external SDRAM for memory.
	  The Cortex-M4 remains reset-held by default and can optionally be
	  managed by N32H7XX_CM4_RPROC.

config ARMV7M_SYSTICK_CLOCKEVENT
	bool
	help
	  Select the ARMv7-M SysTick exception entry for a platform-provided
	  clock event driver.

config SERIAL_N32H7XX
	bool "NSING N32H7xx USART serial and console support"
	depends on TTY
	select SERIAL_CORE
	select SERIAL_CORE_CONSOLE
	select SERIAL_EARLYCON
	help
	  Support for the NSING N32H7xx USART.  The driver lives under
	  mach-nsing because the register block is SoC-private and is not a
	  generic 8250/PL011-compatible UART.
	  It provides the serial console and early boot console on USART1.

config N32H7XX_CM4_RPROC
	bool "NSING N32H7xx Cortex-M4 remoteproc support"
	select REMOTEPROC
	select REMOTEPROC_CDEV
	help
	  Manage the N32H7xx Cortex-M4 from Linux through the remoteproc
	  framework.  Firmware is loaded into the CM4 AHB SRAM window and
	  started only after userspace explicitly requests it.

	  The bootloader must leave the CM4 in reset.  This driver refuses to
	  take ownership of a CM4 that another boot stage has already released.

endif
```

## drivers/dma/nsing/Kconfig
```kconfig
config N32H7XX_DMA
	tristate "N32H7xx AHB DMA controller"
	depends on ARCH_NSING && OF
	select DMA_ENGINE
	select DMA_VIRTUAL_CHANNELS
	help
	  Hardware cyclic slave DMA with per-channel interrupts and DMAMUX routing.
```

## drivers/gpu/drm/nsing/Kconfig
```kconfig
# SPDX-License-Identifier: GPL-2.0-only
config DRM_N32H7XX_LCDC
	tristate "NSING N32H7xx LCD controller"
	depends on DRM && SOC_N32H7XX && OF
	select DRM_CLIENT_SELECTION
	select DRM_GEM_DMA_HELPER
	select DRM_KMS_HELPER
	select DRM_PANEL_BRIDGE
	select FB_PROVIDE_GET_FB_UNMAPPED_AREA if FB && !MMU
	help
	  Atomic modesetting for the N32H7xx parallel RGB LCD controller.
	  Supports RGB565 and XRGB8888 framebuffers, including no-MMU systems.
	  The module is called n32h7xx-lcdc.

config DRM_N32H7XX_GPU
	tristate "NSING N32H7xx 2D GPU"
	depends on DRM && SOC_N32H7XX && OF
	select DRM_GEM_DMA_HELPER
	help
	  Render-node driver for the N32H7xx D/AVE HD clear engine. Provides
	  GEM buffers and synchronous, bounds-checked rectangle fills.
	  This does not provide OpenGL ES or raw command-stream submission.
	  The module is called n32h7xx-gpu.
```

## drivers/media/platform/nsing/Kconfig
```kconfig
# SPDX-License-Identifier: GPL-2.0-only

comment "NSING media platform drivers"

config VIDEO_N32H7XX_JPEG
	tristate "NSING N32H7xx JPEG codec"
	depends on ARCH_NSING || COMPILE_TEST
	help
	  Support the N32H7xx hardware JPEG encoder and decoder through the
	  /dev/jpeg character device and libn32jpeg.  The initial interface
	  supports synchronous GREY8 encoding.

	  To compile this driver as a module, choose M here: the module will be
	  called n32h7xx-jpeg.

config VIDEO_N32H7XX_DVP
	tristate "NSING N32H7xx DVP parallel camera capture"
	depends on V4L_PLATFORM_DRIVERS && VIDEO_DEV
	depends on ARCH_NSING || COMPILE_TEST
	select VIDEOBUF2_DMA_CONTIG
	select VIDEOBUF2_VMALLOC
	select V4L2_FWNODE
	help
	  Capture support for the DVP (Digital Video Port) parallel camera
	  interface on the NSING N32H7xx SoCs.  The DVP has its own AHB master
	  that writes completed frames straight into SDRAM, so the driver hands
	  it a buffer at a time and reports the frame to userspace through the
	  V4L2 capture API.

	  Buffers are allocated from the "memory-region" reserved pool the
	  board describes, or from the largest physically contiguous block the
	  allocator can hand out when there is none.  The kernel runs without
	  an MMU, so vmalloc() is kmalloc() here and a frame cannot be split
	  across pages.

	  A sensor subdevice has to be described in the device tree behind the
	  DVP port; this driver binds it through the media device tree and
	  supports monochrome (8-bit Y), JPEG, RGB565 and YUV422 output from
	  the sensor.

	  To compile this driver as a module, choose M here: the module will be
	  called n32h7xx-dvp.
```

## drivers/mmc/host/nsing/Kconfig
```kconfig
# SPDX-License-Identifier: GPL-2.0-only

config MMC_N32H7XX_SDHCI
	tristate "NSING N32H7xx SDHCI controller"
	depends on ARCH_NSING
	depends on MMC_SDHCI_PLTFM && OF
	select MMC_SDHCI_IO_ACCESSORS
	help
	  Support for the SDHCI-compatible SDMMC controller found on
	  NSING N32H7xx SoCs.  The driver configures the NSING wrapper in
	  front of the standard SDHCI register block.

	  If unsure, say N.
```

## drivers/net/ethernet/nsing/Kconfig
```kconfig
# SPDX-License-Identifier: GPL-2.0-only
#
# NSING network device configuration
#

config NET_VENDOR_NSING
	bool "NSING devices"
	default y
	depends on ARCH_NSING
	help
	  If you have a network (Ethernet) card belonging to this class, say Y.

	  Note that the answer to this question doesn't directly affect the
	  kernel: saying N will just cause the configurator to skip all the
	  questions about NSING cards. If you say Y, you will be asked for your
	  specific card in the following questions.

if NET_VENDOR_NSING

config N32H7XX_ETH
	tristate "NSING N32H7xx on-chip Ethernet MAC"
	default ARCH_NSING
	depends on OF && PHYLIB && OF_MDIO
	help
	  Support for the Ethernet MAC integrated in NSING N32H7xx SoCs.

	  The driver programs the MAC, MTL and DMA blocks directly and talks to
	  the board PHY through the MAC's own MDIO controller.  The clock gates,
	  reset, AFIO interface select and pin muxing are SoC properties and are
	  handled by the mach-nsing code.

endif # NET_VENDOR_NSING
```

## drivers/net/phy/nsing/Kconfig
```kconfig
# SPDX-License-Identifier: GPL-2.0-only
#
# NSING Ethernet PHY configuration
#

config JL1111_PHY
	tristate "JLSemi JL1111 Fast Ethernet PHY"
	help
	  Supports the JLSemi JL1111 10/100 Mbps Ethernet PHY.  The driver
	  also configures the RMII reference clock direction so that the PHY
	  drives REF_CLK for MACs that consume it.
	  To build the driver as a module, choose M here.
```

## drivers/phy/nsing/Kconfig
```kconfig
# SPDX-License-Identifier: GPL-2.0-only
config PHY_N32H7XX_USB
	tristate "NSING N32H7xx USB HS PHY"
	depends on ARCH_NSING || COMPILE_TEST
	depends on OF && HAS_IOMEM
	select GENERIC_PHY
	select MFD_SYSCON
	help
	  Enable the integrated USB high-speed PHYs on N32H7xx SoCs.
	  The USB controller itself is handled by the DWC2 driver.
```

## drivers/pinctrl/nsing/Kconfig
```kconfig
# SPDX-License-Identifier: GPL-2.0-only
#
# NSING pin controller and GPIO configuration
#

config PINCTRL_N32H7XX
	bool "NSING N32H7xx pin controller and GPIO"
	default ARCH_NSING
	depends on OF && GPIOLIB && (ARCH_NSING || COMPILE_TEST)
	select PINMUX
	select PINCONF
	select GENERIC_PINCONF
	select GENERIC_PINCTRL_GROUPS
	select GENERIC_PINMUX_FUNCTIONS
	select GPIOLIB_IRQCHIP
	help
	  Support for the pin controller and the GPIO ports built into the
	  NSING N32H7xx SoCs.  One register block per port holds the mode,
	  alternate-function number, pull, slew rate and drive strength of
	  every pin together with its GPIO data register, so a single driver
	  registers both the pin controller and the eleven GPIO banks.

	  The pin/signal table is generated from the vendor function-remap
	  database, so a board device tree names the signal it wants on a pin
	  instead of an alternate-function number.
```

## drivers/rtc/nsing/Kconfig
```kconfig
# SPDX-License-Identifier: GPL-2.0-only

config RTC_DRV_N32H7XX
	tristate "NSING N32H7xx RTC"
	depends on ARCH_NSING
	depends on OF
	select RTC_LIB
	help
	  Say yes to enable the backup-domain calendar/RTC of the NSING
	  N32H7xx family.  The RTC counts the on-board 32.768 kHz LSE
	  crystal and keeps time across a warm reset.

	  If unsure, say N.
```

## drivers/spi/nsing/Kconfig
```kconfig
# SPDX-License-Identifier: GPL-2.0-only

config SPI_N32H7XX_XSPI
	tristate "NSING N32H7xx XSPI controller"
	depends on ARCH_NSING
	depends on SPI_MASTER && HAS_IOMEM
	select SPI_DESIGNWARE
	help
	  This enables the NSING N32H7xx platform interface to the DWC SSI
	  controller core. SPI messages and SPI memory operations use the
	  existing DesignWare driver.

	  Say Y here if you are building a kernel for an NSING N32H7xx SoC.
```
