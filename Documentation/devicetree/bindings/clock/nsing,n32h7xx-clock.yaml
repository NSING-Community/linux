## Documentation/devicetree/bindings/clock/nsing,n32h7xx-clock.yaml
```yaml
# SPDX-License-Identifier: (GPL-2.0-only OR BSD-2-Clause)
%YAML 1.2
---
$id: http://devicetree.org/schemas/clock/nsing,n32h7xx-clock.yaml#
$schema: http://devicetree.org/meta-schemas/core.yaml#

title: NSING N32H7xx RCC peripheral clocks

maintainers:
  - Tobby Tan <tan.bo@nsingtech.com>

description: |
  The RCC provides the USART1 and BTIM1 clocks derived from AHB1, including
  their run and low-power gates. Clock indices 0 and 1 select USART1 and
  BTIM1. Indices 2 and 3 select the USB1 and USB2 AHB bus clocks, and index
  4 selects the shared USB PHY reference clock derived from HSE without
  prescaling. Reset index 0 selects BTIM1, indices 1 and 2 select USB1 and
  USB2 core reset, and indices 3 and 4 select their PHY power-on resets.
  Clock indices 5 and 6 select DMA1 and DMAMUX1. Indices 7 and 8 select
  the I2S1 and I2S4 kernel clocks from sysbus divided by eight. Reset indices
  5 and 6 select I2S1 and I2S4, and indices 7 and 8 select DMA1 and DMAMUX1.

properties:
  compatible:
    const: nsing,n32h7xx-clock

  reg:
    maxItems: 1

  clocks:
    minItems: 1
    items:
      - description: AHB1 parent clock
      - description: HSE reference clock, required when using USB

  '#clock-cells':
    const: 1

  '#reset-cells':
    const: 1

required:
  - compatible
  - reg
  - clocks
  - '#clock-cells'
  - '#reset-cells'

additionalProperties: false
```

## Documentation/devicetree/bindings/display/nsing,n32h7xx-lcdc.yaml
```yaml
# SPDX-License-Identifier: (GPL-2.0-only OR BSD-2-Clause)
%YAML 1.2
---
$id: http://devicetree.org/schemas/display/nsing,n32h7xx-lcdc.yaml#
$schema: http://devicetree.org/meta-schemas/core.yaml#

title: NSING N32H7xx parallel RGB LCD controller

maintainers:
  - Tobby Tan <tan.bo@nsingtech.com>

description:
  The LCDC scans linear RGB framebuffers from SDRAM and drives a parallel
  RGB panel. The shared DMA pool may also be referenced by the on-chip GPU;
  both masters then allocate from the same pool bitmap.

properties:
  compatible:
    const: nsing,n32h7xx-lcdc
  reg:
    maxItems: 1
  interrupts:
    items:
      - description: Line and register reload events
      - description: FIFO underrun and bus errors
  interrupt-names:
    items:
      - const: event
      - const: error
  clocks:
    items:
      - description: LCDC AXI clock
      - description: LCDC register bus clock
      - description: Pixel clock
  clock-names:
    items:
      - const: bus
      - const: apb
      - const: pixel
  resets:
    maxItems: 1
  memory-region:
    maxItems: 1
  port:
    $ref: /schemas/graph.yaml#/properties/port

required:
  - compatible
  - reg
  - interrupts
  - interrupt-names
  - clocks
  - clock-names
  - resets
  - memory-region
  - port

additionalProperties: false
```

## Documentation/devicetree/bindings/dma/nsing,n32h7xx-dma.yaml
```yaml
# SPDX-License-Identifier: (GPL-2.0-only OR BSD-2-Clause)
%YAML 1.2
---
$id: http://devicetree.org/schemas/dma/nsing,n32h7xx-dma.yaml#
$schema: http://devicetree.org/meta-schemas/core.yaml#

title: NSING N32H7xx AHB DMA controller

maintainers:
  - Tobby Tan <tan.bo@nsingtech.com>

description: |
  DMA1 has eight channels with separate interrupt outputs. DMAMUX1 channel
  registers 0 through 7 select the peripheral requests for DMA1. The DMA
  specifier contains the DMAMUX request number.

allOf:
  - $ref: dma-controller.yaml#

properties:
  compatible:
    const: nsing,n32h7xx-dma
  reg:
    items:
      - description: DMA controller registers
      - description: Eight DMA1 request selector registers in DMAMUX1
  reg-names:
    items:
      - const: dma
      - const: mux
  interrupts:
    minItems: 8
    maxItems: 8
  clocks:
    items:
      - description: DMA bus clock
      - description: DMAMUX bus clock
  clock-names:
    items:
      - const: dma
      - const: mux
  resets:
    maxItems: 1
  '#dma-cells':
    const: 1

required:
  - compatible
  - reg
  - reg-names
  - interrupts
  - clocks
  - clock-names
  - resets
  - '#dma-cells'

unevaluatedProperties: false
```

## Documentation/devicetree/bindings/gpu/nsing,n32h7xx-gpu.yaml
```yaml
# SPDX-License-Identifier: (GPL-2.0-only OR BSD-2-Clause)
%YAML 1.2
---
$id: http://devicetree.org/schemas/gpu/nsing,n32h7xx-gpu.yaml#
$schema: http://devicetree.org/meta-schemas/core.yaml#

title: NSING N32H7xx D/AVE HD 2D GPU

maintainers:
  - Tobby Tan <tan.bo@nsingtech.com>

description:
  The GPU executes command streams from contiguous DMA memory. Its DMA pool
  may be shared with the LCDC. This block has no display output of its own.

properties:
  compatible:
    const: nsing,n32h7xx-gpu
  reg:
    maxItems: 1
  interrupts:
    maxItems: 1
  clocks:
    maxItems: 1
  resets:
    maxItems: 1
  memory-region:
    maxItems: 1

required:
  - compatible
  - reg
  - interrupts
  - clocks
  - resets
  - memory-region

additionalProperties: false
```

## Documentation/devicetree/bindings/mmc/nsing,n32h7xx-sdhci.yaml
```yaml
# SPDX-License-Identifier: (GPL-2.0-only OR BSD-2-Clause)
%YAML 1.2
---
$id: http://devicetree.org/schemas/mmc/nsing,n32h7xx-sdhci.yaml#
$schema: http://devicetree.org/meta-schemas/core.yaml#

title: NSING N32H7xx SDMMC controller

maintainers:
  - Tobby Tan <tan.bo@nsingtech.com>

allOf:
  - $ref: mmc-controller.yaml#

properties:
  compatible:
    const: nsing,n32h7xx-sdhci

  reg:
    items:
      - description: SDHCI host registers
      - description: NSING capability wrapper registers

  interrupts:
    maxItems: 1

  reg-names:
    items:
      - const: host
      - const: wrapper

required:
  - compatible
  - reg
  - interrupts

unevaluatedProperties: false

examples:
  - |
    pinctrl {
        sdmmc1_pins: sdmmc1-pins {
            pins = "PC12", "PD2", "PC8", "PC9", "PC10", "PC11";
            function = "sdmmc1";
            bias-pull-up;
            drive-strength = <2>;
            slew-rate = <0>;
        };
    };

    mmc@51110000 {
        compatible = "nsing,n32h7xx-sdhci";
        reg = <0x51110000 0x400>, <0x51107000 0x400>;
        reg-names = "host", "wrapper";
        interrupts = <135>;
        bus-width = <4>;
        max-frequency = <25000000>;
        broken-cd;
        disable-wp;
        no-1-8-v;
        no-mmc;
        no-sdio;
        pinctrl-names = "default";
        pinctrl-0 = <&sdmmc1_pins>;
    };
```

## Documentation/devicetree/bindings/phy/nsing,n32h7xx-usb-phy.yaml
```yaml
# SPDX-License-Identifier: (GPL-2.0-only OR BSD-2-Clause)
%YAML 1.2
---
$id: http://devicetree.org/schemas/phy/nsing,n32h7xx-usb-phy.yaml#
$schema: http://devicetree.org/meta-schemas/core.yaml#

title: NSING N32H7xx integrated USB high-speed PHY

maintainers:
  - Tobby Tan <tan.bo@nsingtech.com>

description: |
  Each DWC2 controller has an integrated UTMI PHY and a separate wrapper.
  The wrapper configures the PHY PLL and the physical or internal ID signal.
  USB packet RAM is powered by the PWR controller in a shared HSC domain.

properties:
  compatible:
    const: nsing,n32h7xx-usb-phy

  reg:
    maxItems: 1

  '#phy-cells':
    const: 0

  clocks:
    items:
      - description: PHY reference clock
      - description: Controller AHB bus clock

  clock-names:
    items:
      - const: ref
      - const: bus

  resets:
    maxItems: 1

  reset-names:
    const: por

  nsing,pwr:
    $ref: /schemas/types.yaml#/definitions/phandle
    description: PWR syscon controlling USB packet RAM and the HSC domain

  nsing,controller:
    $ref: /schemas/types.yaml#/definitions/uint32
    enum: [1, 2]
    description: Controller number selecting the packet RAM and HSC domain

  nsing,external-id:
    type: boolean
    description: |
      Enable the physical ID input instead of the internal ID signal.
      Only use this when a usable ID signal is connected and pinmuxed.
      Software USB role switching does not require this property.

required:
  - compatible
  - reg
  - '#phy-cells'
  - clocks
  - clock-names
  - resets
  - reset-names
  - nsing,pwr
  - nsing,controller

additionalProperties: false

examples:
  - |
    phy@40140000 {
        compatible = "nsing,n32h7xx-usb-phy";
        reg = <0x40140000 0x8>;
        #phy-cells = <0>;
        clocks = <&rcc 4>, <&rcc 2>;
        clock-names = "ref", "bus";
        resets = <&rcc 3>;
        reset-names = "por";
        nsing,pwr = <&pwr>;
        nsing,controller = <1>;
    };
```

## Documentation/devicetree/bindings/pinctrl/nsing,n32h7xx-pinctrl.yaml
```yaml
# SPDX-License-Identifier: (GPL-2.0-only OR BSD-2-Clause)
%YAML 1.2
---
$id: http://devicetree.org/schemas/pinctrl/nsing,n32h7xx-pinctrl.yaml#
$schema: http://devicetree.org/meta-schemas/core.yaml#

title: NSING N32H7xx pin controller and GPIO

maintainers:
  - Tobby Tan <tan.bo@nsingtech.com>

description: |
  The N32H7xx has eleven GPIO ports (A..K) of sixteen pins each.  One register
  block per port selects the mode, alternate-function number, pull resistor,
  slew rate and drive strength of every pin and also holds its GPIO data
  register, so a single node is both the pin controller and the parent of the
  eleven GPIO banks.

  Which peripheral signal a pin carries is a property of the series and is
  compiled into the driver, so a board only names the pins it uses and the
  signal it wants on them.  A pin is identified by its package name, PA0
  through PK15.

  Pin groups are described as child nodes of the pin controller.  A group is
  either a single pin configuration applied to a list of pins, or a set of
  nested sub-groups when the pins need different configuration.  Every group
  and sub-group node name ends in "-pins".

properties:
  compatible:
    const: nsing,n32h7xx-pinctrl

  reg:
    maxItems: 1

  "#address-cells":
    const: 1

  "#size-cells":
    const: 1

patternProperties:
  "^gpio@[0-9a-f]+$":
    type: object
    additionalProperties: false
    description:
      One GPIO bank per port.  The bank offset inside the pin controller
      register window selects the port, so the banks must be ordered by
      address.

    properties:
      reg:
        maxItems: 1

      gpio-controller: true

      "#gpio-cells":
        const: 2

      gpio-ranges:
        maxItems: 1

    required:
      - reg
      - gpio-controller
      - "#gpio-cells"

  "^[a-z0-9-]+-pins$":
    $ref: "#/$defs/pin-group"

required:
  - compatible
  - reg

additionalProperties: false

$defs:
  pin-group:
    type: object
    description: |
      A pin group.  Either list the pins in "pins" and set "function" plus the
      pad configuration directly, or nest one sub-group per set of pins that
      needs its own configuration.  Sub-group node names also end in "-pins".

    properties:
      pins:
        $ref: /schemas/types.yaml#/definitions/string-array
        description:
          Package pin names, PA0..PK15.

      function:
        $ref: /schemas/types.yaml#/definitions/string
        description: |
          One of:
          - a signal name such as "usart1_tx", which selects the exact
            alternate function that carries that signal;
          - a peripheral name such as "usart1", which selects whatever signal
            that peripheral has on each listed pin;
          - the bare "gpio" or "analog";
          - an explicit "af0".."af15".

          A peripheral name is rejected where it names two different signals on
          one pin; the group then has to spell the exact signal name out.

      bias-disable:
        type: boolean

      bias-pull-up:
        type: boolean

      bias-pull-down:
        type: boolean

      drive-strength:
        $ref: /schemas/types.yaml#/definitions/uint32
        enum: [0, 1, 2, 3]
        description: |
          Raw GPIO drive-strength encoding, not a current in mA.  On a 3.3 V
          IO pad the encodings are 0 = 2 mA, 1 = 8 mA, 2 = 4 mA and 3 = 12 mA.

      slew-rate:
        $ref: /schemas/types.yaml#/definitions/uint32
        enum: [0, 1]
        description: 0 selects fast edges, 1 selects slow edges.

      nsing,hs-drive-strength-high:
        type: boolean
        description:
          On a high-speed pad, select the high-current driver bank instead of
          the low-current one.

      drive-open-drain:
        type: boolean

      drive-push-pull:
        type: boolean

      output-enable:
        type: boolean

      output-low: true

      output-high: true

    patternProperties:
      "^[a-z0-9-]+-pins$":
        $ref: "#/$defs/pin-group"

examples:
  - |
    pinctrl@58032800 {
        compatible = "nsing,n32h7xx-pinctrl";
        reg = <0x58032800 0x2c00>;
        #address-cells = <1>;
        #size-cells = <1>;

        gpioa: gpio@58032800 {
            reg = <0x58032800 0x400>;
            gpio-controller;
            #gpio-cells = <2>;
            gpio-ranges = <&pinctrl 0 0 16>;
        };

        uart1-pins {
            pins = "PA9", "PA10";
            function = "usart1";
            bias-pull-up;
        };

        sdmmc1-pins {
            sdmmc1-ck-pins {
                pins = "PC12";
                function = "sdmmc1_ck";
                bias-disable;
                drive-strength = <1>;
                slew-rate = <0>;
            };

            sdmmc1-data-pins {
                pins = "PD2", "PC8", "PC9", "PC10", "PC11";
                function = "sdmmc1";
                bias-pull-up;
                drive-strength = <2>;
            };
        };
    };
```

## Documentation/devicetree/bindings/power/nsing,n32h7xx-pwr.yaml
```yaml
# SPDX-License-Identifier: (GPL-2.0-only OR BSD-2-Clause)
%YAML 1.2
---
$id: http://devicetree.org/schemas/power/nsing,n32h7xx-pwr.yaml#
$schema: http://devicetree.org/meta-schemas/core.yaml#

title: NSING N32H7xx power control registers

maintainers:
  - Tobby Tan <tan.bo@nsingtech.com>

properties:
  compatible:
    items:
      - const: nsing,n32h7xx-pwr
      - const: syscon

  reg:
    maxItems: 1

required:
  - compatible
  - reg

additionalProperties: false
```
